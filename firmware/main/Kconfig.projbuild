## firmware/main/Kconfig.projbuild
```kconfig
menu "Tomogotchi"

config TOMO_DEBUG_BAGS
    bool "Debug: keep bringing shopping bags home"
    default n
    help
        For testing the shopping bags on the device. He comes home with
        bags at boot, and again whenever the floor is clear, whatever the
        time or Wi-Fi. Bags only show in deadpan, grumpy, night and spooky,
        so during work hours swipe sideways into a costume to see them.
        Leave off for normal builds.

endmenu
```
